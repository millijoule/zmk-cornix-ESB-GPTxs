/*
 * Shared Enhanced ShockBurst addressing for all three Cornix ESB roles.
 * Keep these values identical on the central and both peripherals.
 */
/ {
    esb_split {
        compatible = "zmk,esb-split";
        base-addr-0 = <0xE7 0xE7 0xE7 0xE7>;
        base-addr-1 = <0xC2 0xC2 0xC2 0xC2>;
        addr-prefix = <0xE7 0xC2 0xC3 0xC4 0xC5 0xC6 0xC7 0xC8>;
    };
};
