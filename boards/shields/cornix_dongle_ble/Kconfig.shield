## boards/shields/cornix_dongle_ble/Kconfig.shield
```kconfig
config SHIELD_CORNIX_DONGLE_BLE
    def_bool $(shields_list_contains,cornix_dongle_ble)
```

## boards/shields/cornix_esb_central/Kconfig.shield
```kconfig
config SHIELD_CORNIX_ESB_CENTRAL
    def_bool $(shields_list_contains,cornix_esb_central)
```

## boards/shields/cornix_esb_left/Kconfig.shield
```kconfig
config SHIELD_CORNIX_ESB_LEFT
    def_bool $(shields_list_contains,cornix_esb_left)
```

## boards/shields/cornix_esb_peripheral/Kconfig.defconfig
```kconfig
if SHIELD_CORNIX_ESB_PERIPHERAL

config ZMK_SPLIT_ESB_PERIPHERAL_ID
    default 0 if BOARD_CORNIX_PH_LEFT
    default 1 if BOARD_CORNIX_RIGHT

endif
```

## boards/shields/cornix_esb_peripheral/Kconfig.shield
```kconfig
config SHIELD_CORNIX_ESB_PERIPHERAL
    def_bool $(shields_list_contains,cornix_esb_peripheral)
```

## boards/shields/cornix_esb_right/Kconfig.shield
```kconfig
config SHIELD_CORNIX_ESB_RIGHT
    def_bool $(shields_list_contains,cornix_esb_right)
```

## config/west.yml
```yaml
manifest:
  remotes:
    - name: zmkfirmware
      url-base: https://github.com/zmkfirmware
    - name: urob
      url-base: https://github.com/urob
    - name: englmaxi
      url-base: https://github.com/englmaxi
    - name: cormoran
      url-base: https://github.com/cormoran
    - name: kumbung01
      url-base: https://github.com/kumbung01
    - name: nrfconnect
      url-base: https://github.com/nrfconnect
  projects:
    - name: zmk
      remote: zmkfirmware
      revision: 4dd95d7840eb3d5a3f59bb29fbf1ab054715ef85
      clone-depth: 1
      import:
        file: app/west.yml
    - name: zmk-helpers
      remote: urob
      revision: main
      clone-depth: 1
    # These three commits form a coupled experimental radio stack.
    - name: zmk-split-esb
      remote: kumbung01
      repo-path: zmk-feature-split-esb
      revision: f7b1bd15bfc5e96f3301f328efb2a0df16918b98
      clone-depth: 1
    - name: sdk-nrf
      remote: kumbung01
      revision: 07b7e70c0d223429c58e6cffb4e6ecaa70ff949e
      path: nrf
      clone-depth: 1
    - name: mbedtls
      remote: nrfconnect
      repo-path: sdk-mbedtls
      revision: ncs-v3.1.1
      path: modules/crypto/mbedtls
      clone-depth: 1
    - name: oberon-psa-crypto
      remote: nrfconnect
      repo-path: sdk-oberon-psa-crypto
      revision: ncs-v3.1.1
      path: modules/crypto/oberon-psa-crypto
      clone-depth: 1
    - name: nrfxlib
      remote: nrfconnect
      revision: dfadf17305d8f000eda9aa74a5b9ff1c5647a23e
      repo-path: sdk-nrfxlib
      path: nrfxlib
      clone-depth: 1
    # DYA Studio extensions. ZMK Studio remains enabled as the shared RPC transport.
    - name: zmk-module-settings-rpc
      remote: cormoran
      revision: main
      clone-depth: 1
    - name: zmk-module-runtime-input-processor
      remote: cormoran
      revision: main
      clone-depth: 1
  self:
    path: config
```
